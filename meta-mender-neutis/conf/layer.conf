## meta-mender-neutis/conf/layer.conf
```bitbake
# Board specific layer configuration for meta-mender
# Copyright 2018 Emlid Ltd

# We have a conf and classes directory, add to BBPATH
BBPATH .= ":${LAYERDIR}"

# We have recipes-* directories, add to BBFILES
BBFILES += "${LAYERDIR}/recipes-*/*/*.bb \
	${LAYERDIR}/recipes-*/*/*.bbappend"

BBFILE_COLLECTIONS += "mender-neutis"
BBFILE_PATTERN_mender-neutis = "^${LAYERDIR}/"
BBFILE_PRIORITY_mender-neutis = "10"

LAYERSERIES_COMPAT_mender-neutis = "sumo"
```
